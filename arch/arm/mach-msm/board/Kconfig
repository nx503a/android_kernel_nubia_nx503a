## arch/arm/mach-msm/board/Kconfig
```kconfig
#
# Board configuration
#
menuconfig ARCH_MSM8974
	bool "Select the Supported Board of Nubia"
	help
	  Say Y here, and a list of supported Boards will be displayed.
	  This option doesn't affect the kernel.

	  If unsure, say Y.

if ARCH_MSM8974
	  
config ARCH_MSM8974_ZTEMT
	bool "ZTEMT ARCH_MSM8974"
	help
	  Support for ZTEMT MSM8974AB/AC MTP board.

choice
	depends on ARCH_MSM8974_ZTEMT
	prompt "MSM8974_MTP Based ZTEMT Board"

config BOARD_ZTEMT_NX503A
	bool "ZTEMT NX503A"
	help
	  Support for the ZTEMT NX503A board.	
endchoice	

config ZTEMT_RESTART
	bool "ZTEMT restart"
	help
	  Support for the ZTEMT restart

config EMMC_UNSUPPORTED_HPI
	bool "ZTEMT emmc unsupported hpi feature"
	help
	  emmc unsupported hpi feature.
endif
```
